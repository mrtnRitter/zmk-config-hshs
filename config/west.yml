## config/west.yml
```yaml
manifest:
  remotes:
    - name: zmkfirmware
      url-base: https://github.com/zmkfirmware
    - name: zmk-locales
      url-base: https://github.com/joelspadin
    - name: nice-view-c
      url-base: https://github.com/mrtnRitter
    - name: zzeneg
      url-base: https://github.com/zzeneg
    - name: srwi
      url-base: https://github.com/srwi
  projects:
    - name: zmk
      remote: zmkfirmware
      revision: v0.3.0
      import: app/west.yml
    - name: zmk-locales
      remote: zmk-locales
      revision: main
    - name: nice-view-c
      remote: nice-view-c
      revision: main
    - name: zmk-raw-hid
      remote: zzeneg
      revision: main
    - name: zmk-keypeek-layer-notifier
      remote: srwi
      revision: main
  self:
    path: config
```
